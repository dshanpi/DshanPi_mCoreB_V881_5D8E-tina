## device/config/chips/v861/configs/DshanPi_mCoreB_V881_5D8E/linux-6.6-xuantie/bsp_recovery_defconfig
```kconfig
CONFIG_AW_BSP=y
CONFIG_AW_KERNEL_ORIGIN=y
CONFIG_ARCH_SUN252I=y
CONFIG_AW_IC_BOARD=y
CONFIG_AW_SOC_NAME="V861"
# CONFIG_AW_DDR_CCU is not set
# CONFIG_AW_UART is not set
CONFIG_AW_UART_NG=y
CONFIG_AW_SERIAL_CONSOLE=y
CONFIG_AW_SERLAL_NR_UARTS=4
CONFIG_AW_TIMER_SUN50I=y
# CONFIG_AW_TIMER_DYNAMIC_DEBUG is not set
CONFIG_AW_TIMER_SWAP_IVH_CVL_SPACE=y
CONFIG_AW_DMA=y
CONFIG_AW_RTC=y
CONFIG_AW_RTC_POWEROFF_ALARM=y
# CONFIG_AW_DUMP_REG is not set
CONFIG_AW_WATCHDOG=y
CONFIG_AW_MBUS_GENERIC=y
CONFIG_AW_MMC_HSQ=y
CONFIG_AW_MMC=y
CONFIG_AW_MMC_CQHCI=y
CONFIG_AW_MTD=y
CONFIG_AW_MTD_SUNXI_PARTS=y
# CONFIG_AW_MTD_SPI_NOR_USE_4K_SECTORS is not set
CONFIG_AW_MTD_SPI_NOR_6_1=y
CONFIG_SPIF_SUNXI=y
# CONFIG_AW_VIDEO_ENCODER_DECODER is not set
CONFIG_AW_SYS_INFO=y
CONFIG_AW_SBI=y
CONFIG_AW_SID_V2=y
CONFIG_AW_TWI=y
CONFIG_AW_SPI_NG=y
CONFIG_AW_PWM=y
# CONFIG_AW_INPUT_SENSORINIT is not set
CONFIG_AIC_WLAN_SUPPORT=y
CONFIG_AIC8800_WLAN_SUPPORT=m
CONFIG_AW_SIFIVE_PLIC=y
CONFIG_AW_PM_DOMAINS=y
CONFIG_AW_POWER_DOMAIN_PWRCTL=y
CONFIG_AW_MFD_AXP2101_I2C=y
CONFIG_AW_REGULATOR_AXP2101=y
CONFIG_AW_CPUFREQ_DT=y
CONFIG_ARM_AW_SUN50I_CPUFREQ_NVMEM=y
CONFIG_AW_HWSPINLOCK=y
CONFIG_AW_RFKILL=y
CONFIG_AW_MACADDR_MGT=y
CONFIG_AW_DMABUF_HEAPS_SIZE_POOL=y
# CONFIG_LOCALVERSION_AUTO is not set
CONFIG_SYSVIPC=y
CONFIG_NO_HZ_IDLE=y
CONFIG_HIGH_RES_TIMERS=y
CONFIG_BPF_SYSCALL=y
CONFIG_IKCONFIG=y
CONFIG_IKCONFIG_PROC=y
CONFIG_CGROUPS=y
CONFIG_CGROUP_SCHED=y
CONFIG_CFS_BANDWIDTH=y
CONFIG_CGROUP_BPF=y
CONFIG_NAMESPACES=y
CONFIG_USER_NS=y
CONFIG_CHECKPOINT_RESTORE=y
CONFIG_BLK_DEV_INITRD=y
# CONFIG_RD_BZIP2 is not set
# CONFIG_RD_LZMA is not set
# CONFIG_RD_XZ is not set
# CONFIG_RD_LZO is not set
# CONFIG_RD_LZ4 is not set
# CONFIG_RD_ZSTD is not set
CONFIG_EXPERT=y
CONFIG_NONPORTABLE=y
CONFIG_ARCH_RV32I=y
CONFIG_CMODEL_MEDANY=y
CONFIG_SMP=y
# CONFIG_EFI is not set
CONFIG_CPU_FREQ=y
CONFIG_CPU_FREQ_STAT=y
CONFIG_CPU_FREQ_DEFAULT_GOV_SCHEDUTIL=y
CONFIG_CPU_FREQ_GOV_POWERSAVE=y
CONFIG_CPU_FREQ_GOV_USERSPACE=y
CONFIG_CPU_FREQ_GOV_ONDEMAND=y
CONFIG_CPU_FREQ_GOV_CONSERVATIVE=y
CONFIG_JUMP_LABEL=y
CONFIG_ARCH_MMAP_RND_BITS=17
# CONFIG_STRICT_KERNEL_RWX is not set
CONFIG_MODULES=y
CONFIG_MODULE_UNLOAD=y
CONFIG_CMA=y
CONFIG_NET=y
CONFIG_PACKET=y
CONFIG_UNIX=y
CONFIG_UNIX_DIAG=y
CONFIG_NET_KEY=y
CONFIG_INET=y
CONFIG_IP_MULTICAST=y
CONFIG_IP_ADVANCED_ROUTER=y
CONFIG_IP_FIB_TRIE_STATS=y
CONFIG_IP_MULTIPLE_TABLES=y
CONFIG_INET_IPCOMP=y
CONFIG_INET_UDP_DIAG=y
CONFIG_CFG80211=y
CONFIG_MAC80211=y
CONFIG_RFKILL=y
CONFIG_RFKILL_GPIO=y
CONFIG_DEVTMPFS=y
CONFIG_DEVTMPFS_MOUNT=y
CONFIG_MTD=y
CONFIG_MTD_BLOCK=y
CONFIG_BLK_DEV_LOOP=y
CONFIG_VIRTIO_BLK=m
CONFIG_NETDEVICES=y
CONFIG_PHYLIB=y
CONFIG_INPUT_EVDEV=y
# CONFIG_INPUT_KEYBOARD is not set
# CONFIG_INPUT_MOUSE is not set
CONFIG_SERIO_LIBPS2=y
# CONFIG_VT is not set
# CONFIG_UNIX98_PTYS is not set
# CONFIG_LEGACY_PTYS is not set
# CONFIG_LEGACY_TIOCSTI is not set
# CONFIG_LDISC_AUTOLOAD is not set
CONFIG_VT_HW_CONSOLE_BINDING=y

CONFIG_VIRTIO_CONSOLE=m
# CONFIG_HW_RANDOM is not set
CONFIG_POWER_SUPPLY=y
CONFIG_MFD_SUN6I_PRCM=y
CONFIG_REGULATOR_FIXED_VOLTAGE=y
# CONFIG_VGA_CONSOLE is not set
# CONFIG_USB_SUPPORT is not set
CONFIG_MMC=y
CONFIG_SYNC_FILE=y
CONFIG_DMABUF_HEAPS=y
CONFIG_DMABUF_HEAPS_SYSTEM=y
CONFIG_DMABUF_HEAPS_CMA=y
# CONFIG_VIRTIO_MENU is not set
# CONFIG_SUNXI_CCU is not set
# CONFIG_IOMMU_SUPPORT is not set
CONFIG_IIO=y
CONFIG_IIO_SW_DEVICE=y
CONFIG_GENERIC_PHY=y
CONFIG_OVERLAY_FS=y
CONFIG_MSDOS_FS=y
CONFIG_VFAT_FS=y
CONFIG_EXFAT_FS=y
CONFIG_TMPFS=y
CONFIG_TMPFS_POSIX_ACL=y
CONFIG_JFFS2_FS=y
CONFIG_NLS_CODEPAGE_437=y
CONFIG_NLS_ISO8859_1=y
CONFIG_CRYPTO_ECDH=y
CONFIG_CRYPTO_ARC4=y
CONFIG_CRYPTO_ECB=y
CONFIG_CRYPTO_CRC32C=y
CONFIG_CRYPTO_USER_API_HASH=y
# CONFIG_CRYPTO_HW is not set
CONFIG_CRC16=y
CONFIG_CRC_ITU_T=y
CONFIG_CRC7=y
CONFIG_XZ_DEC=y
CONFIG_DMA_CMA=y
CONFIG_PRINTK_TIME=y
CONFIG_DYNAMIC_DEBUG=y
CONFIG_FRAME_WARN=2048
# CONFIG_RCU_TRACE is not set
```

## rtos/lichee/rtos/projects/Kconfig
```kconfig
choice
    prompt "Configure Application"
    default PROJECT_V861_E907_BGA_PERF1

config PROJECT_V861_E907_BGA_PERF1
	bool "v861 e907 bga_perf1 system"
	select PROJECT_V861_E907
	---help---
		v861 e907 bga_perf1 system

config PROJECT_V861_E907_PERF1
    bool "v861_e907 perf1 system"
    select PROJECT_V861_E907
    ---help---
        the v861_e907 perf1 system

config PROJECT_V861_E907_IPC
    bool "v861_e907 ipc system"
    select PROJECT_V861_E907
    ---help---
        the v861_e907 ipc system

config PROJECT_V861_E907_PERF2
    bool "v861_e907 perf2 system"
    select PROJECT_V861_E907
    ---help---
        the v861_e907 perf2 system

config PROJECT_V861_E907_PERF2_FASTBOOT
    bool "v861_e907 perf2_fastboot system"
    select PROJECT_V861_E907
    ---help---
        the v861_e907 perf2_fastboot system

config PROJECT_V861_E907_AOV
    bool "v861_e907 aov system"
    select PROJECT_V861_E907
    ---help---
        the v861_e907 aov system

config PROJECT_V861_E907_AIGLASS
    bool "v861_e907 aiglass system"
    select PROJECT_V861_E907
    ---help---
        the v861_e907 perf2_aiglass system

config PROJECT_V861_E907_STANDBY
    bool "v861_e907 min system for standby"
    select PROJECT_V861_E907
    ---help---
        the v861_e907 min system for standby

config PROJECT_V861_E907_SC1771V
    bool "v861_e907 sc1771v system"
    select PROJECT_V861_E907
    ---help---
        the v861_e907 sc1771v system

config PROJECT_V861_E907_CDR
    bool "v861_e907 cdr system"
    select PROJECT_V861_E907
    ---help---
        the v861_e907 cdr system

config PROJECT_V861_E907_HMI
    bool "v861_e907 hmi system"
    select PROJECT_V861_E907
    ---help---
        the v861_e907 hmi system

config PROJECT_V861_E907_SDV
    bool "v861_e907 sdv system"
    select PROJECT_V861_E907
    ---help---
        the v861_e907 sdv system

config PROJECT_V861_E907_AIGLASS_SC1770V
    bool "v861_e907 aiglass_sc1770v system"
    select PROJECT_V861_E907
    ---help---
        the v861_e907 aiglass_sc1770v system

config PROJECT_V861_E907_AVAOTA_F2
    bool "v861_e907 avaota_f2 system"
    select PROJECT_V861_E907
    ---help---
        the v861_e907 avaota_f2 system

config PROJECT_V861_E907_DSHANPI_MCOREB_V881_5D8E
    bool "v861_e907 DshanPi_mCoreB_V881_5D8E system"
    select PROJECT_V861_E907
    ---help---
        the v861_e907 DshanPi_mCoreB_V881_5D8E system

endchoice

config PROJECT_V861_E907
    bool

config FPGA_PLATFORM
    bool "Run on fpga"
    default n

config PROJECT_TESTCASE
    bool "Project Testcase"
    default n

config NON_OS
    bool "non os demo"
    default n
    depends on PROJECT_T113_S3P_C906_EVB1_AUTO_NON_OS
```
